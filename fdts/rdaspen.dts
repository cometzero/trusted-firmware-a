/*
 * Copyright (c) 2025-2026, Arm Limited. All rights reserved.
 *
 * SPDX-License-Identifier: BSD-3-Clause
 */

/dts-v1/;

#include <dt-bindings/interrupt-controller/arm-gic.h>
#include "rdaspen-defs.dtsi"

/ {
	model = "RD-Aspen";
	compatible = "arm,rdaspen";
	interrupt-parent = <&gic>;
	#address-cells = <2>;
	#size-cells = <2>;

	chosen {
		stdout-path = &soc_serial0;
	};

	cpus {
		#address-cells = <2>;
		#size-cells = <0>;

		/*
		 * The latency and residency numbers below are for illustrative
		 * purpose only and may vary on actual silicon. These values are
		 * considered just to demonstrate that the cpuidle governor
		 * logic works.
		 */
		idle-states {
			entry-method = "psci";

			CPU_SLEEP: cpu-sleep {
				compatible = "arm,idle-state";
				arm,psci-suspend-param = <0x0010000>;
				local-timer-stop;
				entry-latency-us = <800>;
				exit-latency-us = <3200>;
				min-residency-us = <4200>;
			};
			CLUSTER_SLEEP: cluster-sleep {
				compatible = "arm,idle-state";
				arm,psci-suspend-param = <0x1010000>;
				local-timer-stop;
				entry-latency-us = <1000>;
				exit-latency-us = <3200>;
				min-residency-us = <4500>;
			};
		};

		/* Up to 4 clusters with up to 4 CPU cores in each cluster */
		CPU_MAP
		CPUS
	};

	L3_CACHE
	DSU_PMU

	memory@80000000 {
		device_type = "memory";

		/* Bank 0: start = 0x0000_0000_8000_0000, size = ~2 GiB (0x7F00_0000) */
		/* Bank 1: start = 0x0000_0200_0000_0000, size = 2 GiB  (0x8000_0000) */
		reg = <
			0x00000000  0x80000000  0x00000000  0x7F000000
#if (TFA_PLATFORM_VARIANT == RD_ASPEN_VARIANT_FVP)
			0x00000200  0x00000000  0x00000000  0x80000000
#endif
		>;
	};

	timer {
		compatible = "arm,armv8-timer";
		interrupts = <GIC_PPI 13 IRQ_TYPE_LEVEL_LOW>,
			<GIC_PPI 14 IRQ_TYPE_LEVEL_LOW>,
			<GIC_PPI 11 IRQ_TYPE_LEVEL_LOW>,
			<GIC_PPI 10 IRQ_TYPE_LEVEL_LOW>,
			<GIC_PPI 12 IRQ_TYPE_LEVEL_LOW>;
	};

	soc_clk24mhz: clk24mhz {
		compatible = "fixed-clock";
		#clock-cells = <0>;
		clock-frequency = <24000000>;
		clock-output-names = "refclk24mhz";
	};

	reserved-memory {
		#address-cells = <2>;
		#size-cells = <2>;
		ranges;
		ras_buffer: cper@ffa00000 {
			reg = <0x0 0xffa00000 0x0 0x00100000>;
			no-map;
		};
	};

	soc {
		compatible = "simple-bus";
		#address-cells = <2>;
		#size-cells = <2>;
		ranges;

		timer@1a810000 {
			compatible = "arm,armv7-timer-mem";
			reg = <0x0 0x1a810000 0 0x10000>;
			#address-cells = <1>;
			#size-cells = <1>;
			/* Map child space [0x0..0x30000) to parent @ 0x1a810000 */
			ranges = <0x0 0x0 0x1a810000 0x00030000>;

			frame@20000 {
				frame-number = <0>;
				interrupts = <GIC_SPI 49 IRQ_TYPE_LEVEL_HIGH>;
				reg = <0x20000 0x10000>;
			};
		};

		gic: interrupt-controller@20800000 {
			compatible = "arm,gic-v3";
			#redistributor-regions = <16>;
			reg = <0x0 0x20800000 0x0 0x10000>,    /* GICD */
			      <0x0 0x20880000 0x0 0x40000>,    /* 16 * GICR */
			      <0x0 0x208c0000 0x0 0x40000>,
			      <0x0 0x20900000 0x0 0x40000>,
			      <0x0 0x20940000 0x0 0x40000>,
			      <0x0 0x20980000 0x0 0x40000>,
			      <0x0 0x209c0000 0x0 0x40000>,
			      <0x0 0x20a00000 0x0 0x40000>,
			      <0x0 0x20a40000 0x0 0x40000>,
			      <0x0 0x20a80000 0x0 0x40000>,
			      <0x0 0x20ac0000 0x0 0x40000>,
			      <0x0 0x20b00000 0x0 0x40000>,
			      <0x0 0x20b40000 0x0 0x40000>,
			      <0x0 0x20b80000 0x0 0x40000>,
			      <0x0 0x20bc0000 0x0 0x40000>,
			      <0x0 0x20c00000 0x0 0x40000>,
			      <0x0 0x20c40000 0x0 0x40000>;
			#interrupt-cells = <3>;
			#address-cells = <2>;
			#size-cells = <2>;
			ranges;
			interrupt-controller;
			interrupts = <GIC_PPI 9 IRQ_TYPE_LEVEL_HIGH>;

			its1: msi-controller@20840000 {
				compatible = "arm,gic-v3-its";
				reg = <0x0 0x20840000 0x0 0x40000>;
				msi-controller;
				#msi-cells = <1>;
			};
		};

		/* UART is fixed as 24MHz, both UARTCLK and PCLK */
		soc_serial0: serial@1a400000 {
			compatible = "arm,pl011", "arm,primecell";
			reg = <0x0 0x1a400000 0x0 0x10000>;
			interrupts = <GIC_SPI 52 IRQ_TYPE_LEVEL_HIGH>;
			clocks = <&soc_clk24mhz>, <&soc_clk24mhz>;
			clock-names = "uartclk", "apb_pclk";
		};

		watchdog@1a420000 {
			compatible = "arm,sbsa-gwdt";
			reg = <0x0 0x1a420000 0x0 0x10000>,
			      <0x0 0x1a430000 0x0 0x10000>;
			interrupts = <GIC_SPI 50 IRQ_TYPE_LEVEL_HIGH>;
		};

#if (TFA_PLATFORM_VARIANT == RD_ASPEN_VARIANT_FVP)
		rtc@300d0000 {
			compatible = "arm,pl031", "arm,primecell";
			reg = <0x0 0x300d0000 0x0 0x10000>;
			interrupts = <GIC_SPI 268 IRQ_TYPE_LEVEL_HIGH>;
			clocks = <&soc_clk24mhz>;
			clock-names = "apb_pclk";
		};

		virtio-net@30060000 {
			compatible = "virtio,mmio";
			reg = <0x0 0x30060000 0x0 0x10000>;
			interrupts = <GIC_SPI 261 IRQ_TYPE_LEVEL_HIGH>;
		};

		/* OS storage */
		virtio-block@30020000 {
			compatible = "virtio,mmio";
			reg = <0x0 0x30020000 0x0 0x10000>;
			interrupts = <GIC_SPI 257 IRQ_TYPE_LEVEL_HIGH>;
		};

		/* Distro installation media */
		virtio-block@30030000 {
			compatible = "virtio,mmio";
			reg = <0x0 0x30030000 0x0 0x10000>;
			interrupts = <GIC_SPI 258 IRQ_TYPE_LEVEL_HIGH>;
		};

		/* SystemReady ACS validation media */
		virtio-block@30040000 {
			compatible = "virtio,mmio";
			reg = <0x0 0x30040000 0x0 0x10000>;
			interrupts = <GIC_SPI 259 IRQ_TYPE_LEVEL_HIGH>;
		};

		/* User data media */
		virtio-block@30050000 {
			compatible = "virtio,mmio";
			reg = <0x0 0x30050000 0x0 0x10000>;
			interrupts = <GIC_SPI 260 IRQ_TYPE_LEVEL_HIGH>;
		};

		virtio-rng@30080000 {
			compatible = "virtio,mmio";
			reg = <0x0 0x30080000 0x0 0x10000>;
			interrupts = <GIC_SPI 263 IRQ_TYPE_LEVEL_HIGH>;
		};
#endif

		ras-ffh@ffa00000 {
			compatible = "arm,ras-ffh";
			reg = <0x0 0xffa00000 0x0 0x00100000>;
			status-block-size = <0x00010000>;
			memory-region = <&ras_buffer>;
			interrupts = <GIC_SPI 57 IRQ_TYPE_EDGE_RISING>;
		};

		smmu: iommu@1c0000000
		{
			compatible = "arm,smmu-v3";
			reg = <0x1 0xc0000000 0x0 0x8000000>;
			dma-coherent;
			#iommu-cells = <1>;
			interrupts = <GIC_SPI 65 IRQ_TYPE_EDGE_RISING>;
			interrupt-names = "combined";
			msi-parent = <&its1 0x10000>;
		};
	};

	psci {
		compatible = "arm,psci-1.0", "arm,psci-0.2", "arm,psci";
		method = "smc";
		cpu_suspend = <0xc4000001>;
		cpu_off = <0x84000002>;
		cpu_on = <0xc4000003>;
	};

	sram: sram@104000 {
		compatible = "mmio-sram";
		reg = <0x0 PLAT_ARM_MHU_NS_SHARED_SRAM_BASE 0x0 PLAT_ARM_MHU_NS_SHARED_SRAM_SIZE>;
		#address-cells = <1>;
		#size-cells = <1>;
		ranges = <0 0x0 PLAT_ARM_MHU_NS_SHARED_SRAM_BASE PLAT_ARM_MHU_NS_SHARED_SRAM_SIZE>;

		scmi_shmem_tx: scpshmem-sram-section@0 {
			compatible = "arm,scmi-shmem";
			reg = <0x0 0x100>;
		};
		scmi_shmem_rx: scpshmem-sram-section@100 {
			compatible = "arm,scmi-shmem";
			reg = <0x100 0x100>;
		};
	};

	mbox_db_tx: mhu@40020000 {
		compatible = "arm,mhuv3";
		reg = <0x0 AP_SI_NON_SECURE_MHU_V3_TX_BASE 0x0 MHU_V3_TX_RX_FRAME_SIZE>;
		clocks = <&soc_clk24mhz>;
		#mbox-cells = <3>;
		interrupts = <GIC_SPI 112 IRQ_TYPE_LEVEL_HIGH>;
		interrupt-names = "combined";
	};

	mbox_db_rx: mhu@40060000 {
		compatible = "arm,mhuv3";
		reg = <0x0 AP_SI_NON_SECURE_MHU_V3_RX_BASE 0x0 MHU_V3_TX_RX_FRAME_SIZE>;
		clocks = <&soc_clk24mhz>;
		#mbox-cells = <3>;
		interrupts = <GIC_SPI 113 IRQ_TYPE_LEVEL_HIGH>;
		interrupt-names = "combined";
	};

	firmware {
		scmi {
			compatible = "arm,scmi";
			mbox-names = "tx", "rx";
			mboxes = <&mbox_db_tx 0 0 0 &mbox_db_rx 0 0 0 &mbox_db_rx 0 0 2>;
			shmem = <&scmi_shmem_tx &scmi_shmem_rx>;
			#address-cells = <1>;
			#size-cells = <0>;

			scmi_dvfs: protocol@13 {
				reg = <0x13>;
				#clock-cells = <1>;
			};
		};
	};

};
